## kmod/Kconfig
```kconfig
# SPDX-License-Identifier: GPL-2.0-only

config BOXFS_FS
	tristate "Box archive filesystem support"
	select ZSTD_DECOMPRESS
	select XZ_DEC
	help
	  Box is a read-only archive format optimized for fast random access
	  and efficient storage. This filesystem allows mounting .box archives
	  directly.

	  Box archives support:
	  - Zstd and XZ compression
	  - Extended attributes
	  - Symlinks (internal and external)
	  - Efficient directory indexing via FST

	  The archive parser is Rust compiled by cargo into a freestanding
	  staticlib, so this does not depend on CONFIG_RUST, but building it
	  needs a nightly Rust toolchain with rust-src. See fs/boxfs/README.md.

	  To compile this as a module, choose M here: the module will be
	  called boxfs.

	  If unsure, say N.
```
